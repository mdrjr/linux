/dts-v1/;
/plugin/;

#include <dt-bindings/gpio/meson-g12a-gpio.h>
#include <dt-bindings/gpio/gpio.h>

/ {
	fragment@0 {
		target = <&spicc0>;

		__overlay__ {
			status = "okay";
		};
	};

	fragment@1 {
		target = <&spidev>;

		__overlay__ {
			status = "okay";
		};
	};
};
