/dts-v1/;
/plugin/;

#include <dt-bindings/gpio/meson-g12a-gpio.h>
#include <dt-bindings/gpio/gpio.h>

/ {
	fragment@0 {
		target = <&parport1>;

		__overlay__ {
			status = "okay";

			data-gpios = <&gpio GPIOX_17 GPIO_ACTIVE_LOW>,
				<&gpio GPIOA_15 GPIO_ACTIVE_LOW>,
				<&gpio GPIOX_6 GPIO_ACTIVE_LOW>,
				<&gpio GPIOA_14 GPIO_ACTIVE_LOW>,
				<&gpio GPIOA_4 GPIO_ACTIVE_LOW>,
				<&gpio GPIOA_12 GPIO_ACTIVE_LOW>,
				<&gpio GPIOX_10 GPIO_ACTIVE_LOW>,
				<&gpio GPIOX_19 GPIO_ACTIVE_LOW>;

			status-gpios = <&gpio GPIOX_11 GPIO_ACTIVE_LOW>,
				<&gpio GPIOX_14 GPIO_ACTIVE_LOW>,
				<&gpio GPIOX_15 GPIO_ACTIVE_LOW>,
				<&gpio GPIOX_5 GPIO_ACTIVE_LOW>;
		};
	};

	fragment@1 {
		target = <&i2c3>;

		__overlay__ {
			status = "disabled";
		};
	};
};
