/dts-v1/;
/plugin/;

#include <dt-bindings/gpio/meson-g12a-gpio.h>
#include <dt-bindings/gpio/gpio.h>

/ {
	fragment@0 {
		target = <&parport0>;

		__overlay__ {
			status = "okay";

			data-gpios = <&gpio GPIOX_2 GPIO_ACTIVE_LOW>,
				<&gpio GPIOX_1 GPIO_ACTIVE_LOW>,
				<&gpio GPIOX_8 GPIO_ACTIVE_LOW>,
				<&gpio GPIOX_9 GPIO_ACTIVE_LOW>,
				<&gpio GPIOX_13 GPIO_ACTIVE_LOW>,
				<&gpio GPIOX_16 GPIO_ACTIVE_LOW>,
				<&gpio GPIOX_12 GPIO_ACTIVE_LOW>,
				<&gpio GPIOX_0 GPIO_ACTIVE_LOW>;

			status-gpios = <&gpio GPIOA_13 GPIO_ACTIVE_LOW>,
				<&gpio GPIOX_3 GPIO_ACTIVE_LOW>,
				<&gpio GPIOX_4 GPIO_ACTIVE_LOW>,
				<&gpio GPIOX_7 GPIO_ACTIVE_LOW>;
		};
	};
};
