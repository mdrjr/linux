/dts-v1/;
/plugin/;

#include <dt-bindings/interrupt-controller/irq.h>
#include <dt-bindings/interrupt-controller/arm-gic.h>

/ {
	fragment@0 {
		target = <&mali>;

		__overlay__ {
   			compatible = "amlogic,meson-g12a-mali", "arm,mali-bifrost";

			interrupts = <GIC_SPI 162 IRQ_TYPE_LEVEL_HIGH>,
				<GIC_SPI 161 IRQ_TYPE_LEVEL_HIGH>,
				<GIC_SPI 160 IRQ_TYPE_LEVEL_HIGH>;
			interrupt-names = "job", "mmu", "gpu";
		};
	};
};